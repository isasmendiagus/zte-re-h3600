## linux-v6.6/Documentation/devicetree/bindings/net/dsa/zte,zx279128.yaml
```yaml
# SPDX-License-Identifier: (GPL-2.0-only OR BSD-2-Clause)
%YAML 1.2
---
$id: http://devicetree.org/schemas/net/dsa/zte,zx279128.yaml#
$schema: http://devicetree.org/meta-schemas/core.yaml#

title: ZTE ZX279128S on-chip ethernet switch

maintainers:
  - Agustin Isasmendi <infra@quecomere.com>

description:
  The ZTE ZX279128S SoC integrates a 4-port ethernet switch. The CPU port is
  reached through the on-chip TM/QMG fabric DMA path exposed by the zx279128
  ethernet driver, which acts as the DSA conduit. The switch port is conveyed
  out-of-band in the CPU<->fabric DMA descriptor (see the "zte" DSA tag).

properties:
  compatible:
    const: zte,zx279128-switch

  reg:
    maxItems: 1
    description: NPP/switch control register window.

  ethernet-ports:
    type: object
    patternProperties:
      "^port@[0-5]$":
        $ref: dsa-port.yaml#
        unevaluatedProperties: false

allOf:
  - $ref: dsa.yaml#

required:
  - compatible
  - reg

unevaluatedProperties: false

examples:
  - |
    switch {
        compatible = "zte,zx279128-switch";
        reg = <0x921c0000 0x1000>;

        ethernet-ports {
            #address-cells = <1>;
            #size-cells = <0>;

            port@0 { reg = <0>; label = "lan0"; phy-handle = <&gephy0>; };
            port@1 { reg = <1>; label = "lan1"; phy-handle = <&gephy1>; };
            port@2 { reg = <2>; label = "lan2"; phy-handle = <&gephy2>; };
            port@3 { reg = <3>; label = "lan3"; phy-handle = <&gephy3>; };

            port@5 {
                reg = <5>;
                ethernet = <&sw>;   /* the zx279128 conduit netdev */
                phy-mode = "internal";
                fixed-link {
                    speed = <1000>;
                    full-duplex;
                };
            };
        };
    };
```

## linux-v6.6/Documentation/devicetree/bindings/net/zte,zx279128s-eth.yaml
```yaml
# SPDX-License-Identifier: (GPL-2.0-only OR BSD-2-Clause)
%YAML 1.2
---
$id: http://devicetree.org/schemas/net/zte,zx279128s-eth.yaml#
$schema: http://devicetree.org/meta-schemas/core.yaml#

title: ZTE ZX279128S integrated Ethernet controller

maintainers:
  - Agustin Isasmendi <isasmendi.agus@gmail.com>

description:
  The ZTE ZX279128S SoC integrates a 5-port Gigabit Ethernet switch with
  four internal GePHYs (plus one MAC for an external RGMII PHY), a
  hardware packet processor (NPP), programmable classifier (CLA), packet
  modifier engine (PM), forwarding database (FDB), and a Traffic Manager
  (TM) with IDM DMA rings for CPU-to-switch traffic.

  The driver provides DSA multi-port support with a zte-specific tagger.
  Hardware flow-offload is available via nft-flowtable when the required
  firmware register tables (stock_init block) are loaded.

properties:
  compatible:
    const: "zte,zx279128s-eth"

  reg:
    maxItems: 5
    description:
      Register windows for the on-chip switch and associated blocks.

  reg-names:
    items:
      - const: pon
      - const: npp
      - const: sys_ctrl
      - const: pin_mux
      - const: pon_serdes

  interrupts:
    minItems: 5
    maxItems: 5
    description:
      Hardware interrupt lines. "tm" is the primary CPU-switch traffic IRQ.

  interrupt-names:
    items:
      - const: idm
      - const: npp
      - const: tm
      - const: pon
      - const: pp

  zte,topcrm:
    $ref: /schemas/types.yaml#/definitions/phandle
    description:
      Phandle to the TOPCRM clock/reset controller node.

  zte,gephys:
    $ref: /schemas/types.yaml#/definitions/phandle-array
    description:
      Array of up to 5 phandles to the internal GePHY nodes
      (gephy0 through gephy3, plus an optional wanphy for the
      external RGMII port).

  memory-region:
    maxItems: 1
    description:
      Reserved memory region for BMU buffer pools, ACL RAM,
      flow RAM, and descriptor rings. This is the pdt_mem
      carved region matching stock firmware layout at
      0x4C000000-0x4FFFFFFF (64 MiB).

  status: true

required:
  - compatible
  - reg
  - reg-names
  - interrupts
  - interrupt-names
  - zte,gephys

additionalProperties: true

examples:
  - |
    #include <dt-bindings/interrupt-controller/arm-gic.h>
    eth {
        compatible = "zte,zx279128s-eth";
        reg = <0x92000000 0x1c0000>,
              <0x921c0000 0x200000>,
              <0x94100000 0x1000>,
              <0x94200000 0x1000>,
              <0x9fe00000 0x100000>;
        reg-names = "pon", "npp", "sys_ctrl", "pin_mux", "pon_serdes";
        interrupts = <GIC_SPI 38 IRQ_TYPE_LEVEL_HIGH>,
                     <GIC_SPI 35 IRQ_TYPE_LEVEL_HIGH>,
                     <GIC_SPI 36 IRQ_TYPE_LEVEL_HIGH>,
                     <GIC_SPI 66 IRQ_TYPE_LEVEL_HIGH>,
                     <GIC_SPI 37 IRQ_TYPE_LEVEL_HIGH>;
        interrupt-names = "idm", "npp", "tm", "pon", "pp";
        zte,topcrm = <&topcrm 0>;
        zte,gephys = <&gephy0>, <&gephy1>, <&gephy2>, <&gephy3>;
        memory-region = <&carved>;
    };
```

## linux-v6.6/Documentation/devicetree/bindings/net/zte,zx279128s-mdio.yaml
```yaml
# SPDX-License-Identifier: (GPL-2.0-only OR BSD-2-Clause)
%YAML 1.2
---
$id: http://devicetree.org/schemas/net/zte,zx279128s-mdio.yaml#
$schema: http://devicetree.org/meta-schemas/core.yaml#

title: ZTE ZXIC ZX279128S MDIO bus controller

description: |
  Small (24-byte) MDIO master block embedded in the ZX279128S SoC,
  used to drive the four built-in GePHYs that sit behind the on-chip
  switch. Standard IEEE 802.3 Clause-22 transactions only; no C45.

maintainers:
  - Agustin Isasmendi <infra@quecomere.com>

allOf:
  - $ref: mdio.yaml#

properties:
  compatible:
    const: zte,zx279128s-mdio

  reg:
    maxItems: 1
    description: 24-byte register window

required:
  - compatible
  - reg

unevaluatedProperties: false

examples:
  - |
    mdio@9a101000 {
        compatible = "zte,zx279128s-mdio";
        reg = <0x9a101000 0x18>;
        #address-cells = <1>;
        #size-cells = <0>;

        ethernet-phy@0 {
            reg = <0>;
        };
    };
```

## linux-v6.6/Documentation/devicetree/bindings/pci/zte,zx279128s-pcie.yaml
```yaml
# SPDX-License-Identifier: (GPL-2.0-only OR BSD-2-Clause)
%YAML 1.2
---
$id: http://devicetree.org/schemas/pci/zte,zx279128s-pcie.yaml#
$schema: http://devicetree.org/meta-schemas/core.yaml#

title: ZTE ZXIC ZX279128S PCIe host controller

description: |
  The ZX279128S SoC integrates two Synopsys DesignWare PCIe Root Port
  controllers. Each port has its own DBI region plus a SoC-specific
  control block (used to read the LTSSM mirror state). Clocks and
  resets are exposed through three syscon regions (TOPCRM, PCIe-CRM,
  PCIe-CRM2).

maintainers:
  - Agustin Isasmendi <infra@quecomere.com>

allOf:
  - $ref: /schemas/pci/snps,dw-pcie.yaml#

properties:
  compatible:
    const: zte,zx279128s-pcie

  reg:
    items:
      - description: Synopsys DesignWare DBI registers
      - description: SoC control registers (LTSSM mirror, link status)

  reg-names:
    items:
      - const: dbi
      - const: soc_ctrl

  interrupts:
    items:
      - description: Main controller interrupt
      - description: MSI interrupt

  interrupt-names:
    items:
      - const: main
      - const: msi

  zte,port-id:
    description: |
      Index of the PCIe port (0 or 1). Selects which clock-gate / reset
      bit pattern to apply during start_link, since the two ports use
      different bit positions in TOPCRM.
    $ref: /schemas/types.yaml#/definitions/uint32
    enum: [0, 1]

  zte,topcrm:
    description: phandle to the TOPCRM syscon (clocks + main resets)
    $ref: /schemas/types.yaml#/definitions/phandle

  zte,pcie-crm:
    description: phandle to the PCIe-CRM syscon (sub-resets / PHY)
    $ref: /schemas/types.yaml#/definitions/phandle

  zte,pcie-crm2:
    description: phandle to the secondary PCIe CRM syscon (lane control)
    $ref: /schemas/types.yaml#/definitions/phandle

required:
  - compatible
  - reg
  - reg-names
  - interrupts
  - interrupt-names
  - zte,port-id
  - zte,topcrm
  - zte,pcie-crm
  - zte,pcie-crm2

unevaluatedProperties: false

examples:
  - |
    #include <dt-bindings/interrupt-controller/arm-gic.h>

    soc {
        #address-cells = <1>;
        #size-cells = <1>;

        topcrm: syscon@94000000 {
            compatible = "zte,zx279128s-topcrm", "syscon";
            reg = <0x94000000 0x1000>;
        };

        pcie_crm: syscon@94100000 {
            compatible = "zte,zx279128s-pcie-crm", "syscon";
            reg = <0x94100000 0x1000>;
        };

        pcie_crm2: syscon@94200000 {
            compatible = "zte,zx279128s-pcie-crm2", "syscon";
            reg = <0x94200000 0x1000>;
        };

        pcie@f000000 {
            compatible = "zte,zx279128s-pcie";
            reg = <0x0f000000 0x4000>,
                  <0x09500000 0x4000>;
            reg-names = "dbi", "soc_ctrl";

            #address-cells = <3>;
            #size-cells = <2>;
            device_type = "pci";
            bus-range = <0x00 0xff>;
            ranges = <0x82000000 0 0x10000000 0x10000000 0 0x08000000>;

            interrupts = <GIC_SPI 0x3f IRQ_TYPE_LEVEL_HIGH>,
                         <GIC_SPI 0x3b IRQ_TYPE_LEVEL_HIGH>;
            interrupt-names = "main", "msi";

            zte,port-id = <0>;
            zte,topcrm = <&topcrm>;
            zte,pcie-crm = <&pcie_crm>;
            zte,pcie-crm2 = <&pcie_crm2>;
        };
    };
```

## linux-v6.6/arch/arm/mach-zx/Kconfig
```kconfig
# SPDX-License-Identifier: GPL-2.0-only
menuconfig ARCH_ZX
	bool "ZTE ZXIC SoCs"
	depends on ARCH_MULTI_V7
	help
	  Support for ZTE ZX279128S and related SoCs.

if ARCH_ZX

config SOC_ZX279128S
	bool "ZTE ZX279128S"
	default y
	help
	  Cortex-A9 dual-core SoC used in H3600 routers.

endif
```

## linux-v6.6/drivers/net/dsa/zte/Kconfig
```kconfig
# SPDX-License-Identifier: GPL-2.0-only
config NET_DSA_ZTE_ZX279128
	tristate "ZTE ZX279128S on-chip switch support"
	depends on NET_DSA
	select NET_DSA_TAG_ZTE
	help
	  This enables support for the ZTE ZX279128S SoC's on-chip 4-port
	  ethernet switch, using DSA. The CPU-port conduit is the zx279128
	  ethernet driver; the switch port is carried out-of-band in the
	  CPU<->fabric DMA descriptor (see the zte tag driver).
```

## linux-v6.6/drivers/net/ethernet/zte/Kconfig
```kconfig
# SPDX-License-Identifier: GPL-2.0
#
# ZTE ZXIC ZX279128S ethernet driver
#

config NET_VENDOR_ZTE
	bool "ZTE devices"
	default y
	depends on OF || COMPILE_TEST
	help
	  If you have a network (Ethernet) card belonging to this family of
	  ZTE/ZXIC SoCs, say Y here.

	  Note that the answer to this question doesn't directly affect the
	  kernel: saying N will just cause the configurator to skip all the
	  questions about ZTE devices. If you say Y, you will be asked for
	  your specific card in the following questions.

if NET_VENDOR_ZTE

config ZX279128_ETH
	tristate "ZTE ZX279128S Ethernet (idm0/idm1)"
	depends on ARCH_ZX || COMPILE_TEST
	depends on OF
	select PHYLIB
	help
	  This driver supports the integrated ethernet block of ZTE's ZXIC
	  ZX279128S SoC. It exposes two netdevs (idm0 / idm1) driven by an
	  on-chip NPP/IDM packet processor. Four GePHYs sit on an internal
	  MDIO bus and connect to RJ45 ports via a hardware switch.

	  To compile this driver as a module, choose M here. The module will
	  be called zx279128-eth.

endif # NET_VENDOR_ZTE
```
